## nrfconnect/Kconfig
```kconfig
mainmenu "Matter nRF Connect Soil Sensor Example Application"

config STATE_LEDS
    bool "Use LEDs to indicate the device state"
    default y

# Thread networking setup
if NET_L2_OPENTHREAD

choice OPENTHREAD_NORDIC_LIBRARY_CONFIGURATION
	default OPENTHREAD_NORDIC_LIBRARY_FTD
endchoice

choice OPENTHREAD_DEVICE_TYPE
	default OPENTHREAD_FTD
endchoice

endif # NET_L2_OPENTHREAD

# Include CHIP (Matter) feature and default definitions
rsource "../connectedhomeip/config/nrfconnect/chip-module/Kconfig.features"
rsource "../connectedhomeip/config/nrfconnect/chip-module/Kconfig.defaults"

# Include Zephyr symbols
source "Kconfig.zephyr"

# --- shim to satisfy CHIP defaults on NCS v2.8 (symbol not present upstream) ---
config BT_BUF_ACL_RX_COUNT_EXTRA
    int
    default 0
    help
      Compatibility shim for NCS v2.8. CHIP defaults may reference this
      symbol; defining it here prevents “defined without a type” warnings.
# -------------------------------------------------------------------------------


# ---- CHIP Wi-Fi reconnection knobs (app-local definitions) ----
config CHIP_WIFI_CONNECTION_RECOVERY_MINIMUM_INTERVAL
    int "CHIP Wi-Fi reconnection min interval (ms)"
    default 1000

config CHIP_WIFI_CONNECTION_RECOVERY_MAXIMUM_INTERVAL
    int "CHIP Wi-Fi reconnection max interval (ms)"
    default 60000

config CHIP_WIFI_CONNECTION_RECOVERY_JITTER
    int "CHIP Wi-Fi reconnection jitter (ms)"
    default 500

config CHIP_WIFI_CONNECTION_RECOVERY_MAX_RETRIES_NUMBER
    int "CHIP Wi-Fi reconnection max retries"
    default 20

config CHIP_WIFI
    bool "Enable CHIP Wi-Fi path"
    default y

config CHIP_DEVICE_COUNTRY_CODE
    string "CHIP device country code"
    default "SE"
    help
      Two-letter ISO 3166-1 country code reported via the Basic Information
      cluster. Configure this to reflect the device's manufacturing locale.

config SOIL_ENDPOINT
    bool "Enable Soil Measurement endpoint"
    default n
    help
      Enable the provisional SoilMeasurement endpoint (EP1). Keep disabled for
      certification builds to avoid advertising provisional clusters.
```

## nrfconnect/Kconfig.sysbuild.bak
```kconfig
#
# Soil Sensor sysbuild Kconfig (clean, non-conflicting)
#

#### Radio core selection
config NRF_DEFAULT_IPC_RADIO
    default y

# Enable IEEE802.15.4 serialization to network core
config NETCORE_IPC_RADIO_IEEE802154
    default y if SOC_SERIES_NRF53X && !WIFI_NRF70

# Enable Bluetooth serialization to network core
config NETCORE_IPC_RADIO_BT_HCI_IPC
    default y if SOC_SERIES_NRF53X

menu "Soil Sensor sysbuild options"

config MATTER
    bool "Build with Matter"
    default y

config MATTER_OTA
    bool "Enable Matter OTA Requestor"
    default n

config WIFI_NRF70
    bool "Use nRF70 Wi-Fi"
    default y
# NOTE: Do NOT define NETCORE_HCI_IPC here. It is a choice defined by NCS.

endmenu

if BOOTLOADER_MCUBOOT

#### DFU multi-image support
config DFU_MULTI_IMAGE_PACKAGE_BUILD
    default y

config DFU_MULTI_IMAGE_PACKAGE_APP
    default y

config PM_EXTERNAL_FLASH_MCUBOOT_SECONDARY
    default y

#### DFU network core configuration
if SOC_SERIES_NRF53X

config MCUBOOT_UPDATEABLE_IMAGES
    default 2

choice MCUBOOT_MODE
    default MCUBOOT_MODE_OVERWRITE_ONLY
endchoice

choice BOOT_SIGNATURE_TYPE
    default BOOT_SIGNATURE_TYPE_RSA
endchoice

config SECURE_BOOT_NETCORE
    default y

config NETCORE_APP_UPDATE
    default y

config DFU_MULTI_IMAGE_PACKAGE_NET
    default y

endif # SOC_SERIES_NRF53X
endif # BOOTLOADER_MCUBOOT

# Pull in Zephyr/NCS sysbuild Kconfig last
source "${ZEPHYR_BASE}/share/sysbuild/Kconfig"
```
